/***************************************************
    პინების და ცვლადების განსაზღვრა
 ***************************************************/
int ledPin = 3;       // პინი LED-ისთვის (PWM)
int analogPin = A0;    // პინი LED-ისთვის (PWM)
int val = 0;          // მიმდინარე მნიშვნელობა პოტენციომეტრიდან
int minVal = 1023;    // მინიმალური მნიშვნელობა (განახლდება დაკალიბრებისას)
int maxVal = 0;       // მაქსიმალური მნიშვნელობა (განახლდება დაკალიბრების შემდეგ)

/***************************************************
   დაყენების ფუნქცია: კონფიგურაცია და კალიბრაცია
 ***************************************************/
void setup() {
  pinMode(ledPin, OUTPUT);
  Serial.begin(9600);

  /***********************************************
    კალიბრაციის ნაბიჯი: პოტენციომეტრი
    5 წამის განმავლობაში გადააქცევს მინიმუმიდან მაქსიმუმზე
   ***********************************************/
  Serial.println("Calibration... Turn the potentiometer from minimum to maximum");
  unsigned long startTime = millis();
  while (millis() - startTime < 5000) { // 5 წამი კალიბრაციისთვის
    val = analogRead(analogPin);
    if (val < minVal) minVal = val;     // განაახლეთ მინიმალური მნიშვნელობა
    if (val > maxVal) maxVal = val;     // განაახლეთ მაქსიმალური მნიშვნელობა
    delay(10);                          // მცირე შეფერხება სტაბილურობისთვის
  }

  /****************************
         შედეგების ჩვენება
           კალიბრაციები
   ****************************/
  Serial.print("Minimum value :  ");
  Serial.println(minVal);
  Serial.print("Maximum value :  ");
  Serial.println(maxVal);
}

/********************************************************
        ფუნქცია loop: სიკაშკაშის კონტროლის
                  ძირითადი ლოგიკა
 ********************************************************/
void loop() {
  val = analogRead(analogPin);          //  მიმდინარე მნიშვნელობის წაკითხვა
  Serial.println(val);                  // გამომავალი მონაცემების გამართვისთვის
  int mappedVal = map(val, minVal, maxVal, 0, 255); // ჩვენება 0–255
  mappedVal = constrain(mappedVal, 0, 255); // დიაპაზონის შეზღუდვა
  analogWrite(ledPin, mappedVal);       // სიკაშკაშის დაყენება
}
